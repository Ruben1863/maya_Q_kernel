## drivers/misc/mediatek/sensors-1.0/alsps/gp2ap030a/Kconfig
```kconfig
config MTK_GP2AP030A
	tristate "GP2AP030A for MediaTek package"
	default n
	help
	  It support different type sensor
	  in this platform. If this option
	  is set, it will support sensor GP2AP030A
	  which integrates a proximity sensor, a color sensor.
```
